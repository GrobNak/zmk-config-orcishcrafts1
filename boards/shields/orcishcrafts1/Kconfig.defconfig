## boards/shields/orcishcrafts1/Kconfig.defconfig
```kconfig
# SPDX-License-Identifier: MIT

if ORCISHCRAFTS1

config ZMK_DISPLAY
    def_bool y

config LVGL
    def_bool y

config LV_COLOR_DEPTH
    int
    default 16

config ZMK_SPLIT
    def_bool y

endif
```

## boards/shields/orcishcrafts1/Kconfig.shield
```kconfig
# SPDX-License-Identifier: MIT

menuconfig ORCISHCRAFTS1_LEFT
    bool "OrcishCrafts1 Left"
    select ZMK_DISPLAY
    select LVGL
    select SPLIT_KEYBOARD

menuconfig ORCISHCRAFTS1_RIGHT  
    bool "OrcishCrafts1 Right"
    select ZMK_DISPLAY
    select LVGL
    select SPLIT_KEYBOARD
```

## config/west.yml
```yaml
manifest:
  defaults:
    revision: v0.3
  remotes:
    - name: zmkfirmware
      url-base: https://github.com/zmkfirmware
    - name: petejohanson
      url-base: https://github.com
  projects:
    - name: zmk
      remote: zmkfirmware
      import: app/west.yml
    - name: zmk-st7789
      remote: petejohanson
      revision: main
  self:
    path: config
```
